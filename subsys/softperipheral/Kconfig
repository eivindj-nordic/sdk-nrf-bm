## subsys/softperipheral/Kconfig
```kconfig
#
# Copyright (c) 2026 Nordic Semiconductor
#
# SPDX-License-Identifier: LicenseRef-Nordic-5-Clause
#

menuconfig BM_SOFTPERIPHERAL
	bool "Softperipheral is present"
	depends on NRFX_GPIOTE

if BM_SOFTPERIPHERAL

choice BM_SOFTPERIPHERAL_SELECTION
	prompt "Softperipheral selection"
	default BM_SOFTPERIPHERAL_NONE

config BM_SOFTPERIPHERAL_NONE
	bool "No Softperipheral"

endchoice

rsource "sCAN/Kconfig"
rsource "sEMMC/Kconfig"
rsource "sQSPI/Kconfig"

endif # BM_SOFTPERIPHERAL
```

## subsys/softperipheral/sCAN/Kconfig
```kconfig
#
# Copyright (c) 2026 Nordic Semiconductor
#
# SPDX-License-Identifier: LicenseRef-Nordic-5-Clause
#

choice BM_SOFTPERIPHERAL_SELECTION

config BM_SOFTPERIPHERAL_SCAN
	bool "sCAN"

endchoice

if BM_SOFTPERIPHERAL_SCAN

config BM_SOFTPERIPHERAL_SCAN_RXFILTER_MAX_BUFFER_SIZE
	int "Maximum size of the RXFILTER buffer"
	default 4

config BM_SOFTPERIPHERAL_SCAN_MAX_DATA_LENGTH
	int "Maximum number of bytes to send in a TX attempt"
	default 8

endif # BM_SOFTPERIPHERAL_SCAN
```

## subsys/softperipheral/sEMMC/Kconfig
```kconfig
#
# Copyright (c) 2026 Nordic Semiconductor
#
# SPDX-License-Identifier: LicenseRef-Nordic-5-Clause
#

choice BM_SOFTPERIPHERAL_SELECTION

config BM_SOFTPERIPHERAL_SEMMC
	bool "sEMMC"

endchoice

if BM_SOFTPERIPHERAL_SEMMC

config BM_SOFTPERIPHERAL_SEMMC_RESPONSE_SIZE
	int "Word size of eMMC response"
	default 4

config BM_SOFTPERIPHERAL_SEMMC_TRANSFERS_PER_REQUEST
	int "Transfers per request"
	default 1

endif # BM_SOFTPERIPHERAL_SEMMC
```

## subsys/softperipheral/sQSPI/Kconfig
```kconfig
#
# Copyright (c) 2026 Nordic Semiconductor
#
# SPDX-License-Identifier: LicenseRef-Nordic-5-Clause
#


choice BM_SOFTPERIPHERAL_SELECTION

config BM_SOFTPERIPHERAL_SQSPI
	bool "sQSPI"

endchoice

if BM_SOFTPERIPHERAL_SQSPI

config BM_SOFTPERIPHERAL_SQSPI_MAX_NUM_DATA_LINES
	int "Maximum data lines"
	range 1 8
	default 2

config BM_SOFTPERIPHERAL_SQSPI_TRANSFERS_PER_REQUEST
	int "Transfers per request"
	default 1

endif # BM_SOFTPERIPHERAL_SQSPI
```
